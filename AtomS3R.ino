#include <M5Unified.h>
#include "WiFi.h"
#include <esp_wifi.h>
#include "ESP32_NOW.h"
#include <esp_mac.h>
#include <math.h>
#include <Preferences.h>


#define DEVICE_IDENTIFIER "M5AtomS3R"

#define HOME_SCREEN 0
#define PAIRING_SCREEN 1

Preferences preferences;
extern const uint8_t jpg[];
static LGFX_Sprite memlcd(&M5.Lcd);
float fwdWatt_f = 0;
float refWatt_f = 0;
int fwdWatt = 0;
int refWatt = 0;
float freq  = 0;
float swr   = 0;
uint8_t wifiChannel = 1;
uint8_t thisMacAddr[6];
bool sendPairingRequests = false;
unsigned long lastBroadcastMillis = millis();
int currentScreen = HOME_SCREEN;

typedef struct nowDataStruct {
  float fwdMv;
  float refMv;
  int freq;
  float vCal;
  float fCal;
} nowDataStruct;

nowDataStruct nowData;

void drawHomeScreen();

class nannyPeerClass : public ESP_NOW_Peer {
public:
  nannyPeerClass(const uint8_t *mac_addr, uint8_t channel, wifi_interface_t iface, const uint8_t *lmk) : ESP_NOW_Peer(mac_addr, channel, iface, lmk) {}
  ~nannyPeerClass() {}

  bool addPeer() {
    if (!add()) {
      printf("Failed to register the nanny peer");
      return false;
    }
    return true;
  }

  void onReceive(const uint8_t *data, size_t len, bool broadcast) {
    printf("onReceive\n");
    if (sendPairingRequests && (memcmp((char*)data, "accepted", 8) == 0)) {
      // printf("Nanny peer received accept message while in pairing mode\n");
      sendPairingRequests = false;
      drawPairedScreen();
    } else {
      printf("Received measurement from nanny " MACSTR " (%s)\n", MAC2STR(addr()), broadcast ? "broadcast" : "unicast");
      memcpy(&nowData, data, sizeof(nowDataStruct));
      // printf("Measurement fwdMv = %f, refMv = %f\n", nowData.fwdMv, nowData.refMv);
      freq = nowData.freq/1000;
      float freqCorrection = nowData.fCal * log10(freq);
      if ((freq >= 5) && (freq < 15)) {
        fwdWatt_f =  pow(10, (nowData.fwdMv - nowData.vCal + 7.7 + freqCorrection)/250);
        refWatt_f =  pow(10, (nowData.refMv - nowData.vCal + 7.7 + freqCorrection)/250);
      } else {
        fwdWatt_f =  pow(10, (nowData.fwdMv - nowData.vCal + freqCorrection)/250);
        refWatt_f =  pow(10, (nowData.refMv - nowData.vCal + freqCorrection)/250);
      }
      fwdWatt = round(fwdWatt_f);
      refWatt = round(refWatt_f);
      if ((fwdWatt_f > 0) && (refWatt_f > 0)) {
          swr = ((1+sqrt(refWatt_f/fwdWatt_f))/(1-sqrt(refWatt_f/fwdWatt_f)));
      } else {
          swr = (1.0);
      }
      drawHomeScreen();
    }
  }
};
nannyPeerClass * nannyPeer = NULL;

void catchPairedMessage(const esp_now_recv_info_t *info, const uint8_t *data, int len, void *arg) {       // registered by broadcast peer to catch accepted when the peer is unknown (not created already from settings)
  printf("catchPairedMessage %s\n", (char *)data);
  if (!sendPairingRequests) return;
  sendPairingRequests = false;        // hold the sending of pairing requests (assume we are accepted else start sending again)
  if ((memcmp(info->des_addr, ESP_NOW.BROADCAST_ADDR, 6) != 0) && (memcmp((char*)data, "accepted", 8) == 0)) { // if message was sent to peer (not broadcast) and starts with "accepted" -> it is an accepted message
    printf("accept message okay, creating nannyPeer\n");
    delete nannyPeer;                 // if there was a peer delete it for deconstruct
    nannyPeer = new nannyPeerClass(info->src_addr, wifiChannel, WIFI_IF_STA, NULL);
    nannyPeer->addPeer();
    preferences.begin("settings", false);
      preferences.putBytes("savedNanny", nannyPeer->addr(), 6);
    preferences.end();
    drawPairedScreen();
  } else {
    sendPairingRequests = true;
  }
}

class broadcastClass : public ESP_NOW_Peer {
public:
  broadcastClass(uint8_t channel, wifi_interface_t iface, const uint8_t *lmk) : ESP_NOW_Peer(ESP_NOW.BROADCAST_ADDR, channel, iface, lmk) {}
  ~broadcastClass() {remove();}

  bool begin() {
    if (!ESP_NOW.begin() || !add()) {
      printf("Failed to initialize ESP-NOW or register the broadcast peer");
      return false;
    }
    ESP_NOW.onNewPeer(catchPairedMessage, NULL);
    return true;
  }

  bool sendPairRequestMessage(uint8_t ch) {
    setChannel(ch);
    String pairingMessage = DEVICE_IDENTIFIER;
    pairingMessage += '-';
    pairingMessage += String(ch);
    char data[32];
    snprintf(data, sizeof(data), pairingMessage.c_str());
    // printf("Broadcasting message: %s\n", data);
    if (!send((uint8_t *)data, sizeof(data))) {
      printf("Failed to broadcast message");
      return false;
    }
    return true;
  }

  void onReceive(const uint8_t *data, size_t len, bool broadcast) {
    Serial.printf("Broadcast peer: Received message from Nanny " MACSTR " (%s)\n", MAC2STR(addr()), broadcast ? "broadcast" : "unicast");
    Serial.printf("  Message: %s\n", (char *)data);
  }
};
broadcastClass broadcast(wifiChannel, WIFI_IF_STA, NULL);

void setOrientation() {
  int savOrientation = memlcd.getRotation();
  auto imu_update = M5.Imu.update();
  if (imu_update) {
    auto data = M5.Imu.getImuData();
    if ((data.accel.x <= 0.5) && (data.accel.x >= -0.5) && (data.accel.y > 0.5)) {
      memlcd.setRotation(0);
    } else if ((data.accel.x < -0.5) && (data.accel.y <= 0.5) && (data.accel.y >= -0.5)) {
      memlcd.setRotation(3);
    } else if ((data.accel.x > 0.5) && (data.accel.y <= 0.5) && (data.accel.y >= -0.5)) {
      memlcd.setRotation(1);
    } else if ((data.accel.x <= 0.5) && (data.accel.x >= -0.5) && (data.accel.y < -0.5)) {
      memlcd.setRotation(2);
    }
    if (memlcd.getRotation() != savOrientation) {
      if (currentScreen == HOME_SCREEN) {
        drawHomeScreen();
      } else {
        drawPairingScreen();
      }
    }
  } else {
    printf("IMU update failed\n");
  }
}

void drawHomeFrame() {
  memlcd.fillRect(0, 0, 128, 128, 0x000000);
  memlcd.drawRect(0, 0, 20, 128, 0x780F);   // Fwd cel
  memlcd.drawRect(19, 0, 20, 128, 0x780F);  // Ref cel
  memlcd.drawRect(38, 0, 90, 128, 0x780F);  // Power, freq, SWR, Temp cel
  memlcd.setFont(&fonts::FreeSansBold9pt7b);
  memlcd.drawChar( 4, 119, 'F', WHITE, BLACK, 1, 1);
  memlcd.drawChar( 23, 119, 'R', WHITE, BLACK, 1, 1);
}

void drawPairingFrame() {
  memlcd.fillRect(0, 0, 128, 128, 0x000000);
  memlcd.drawRect(0, 0, 128, 128, 0x780F);   // screen border
}

void drawChannel() {
  char stringBuffer [3];
  itoa (wifiChannel,stringBuffer,10);                                                       
  memlcd.drawString(stringBuffer, 64, 32, &fonts::FreeSansBoldOblique24pt7b);   // channel string
  memlcd.drawString("click=chan", 62, 63, &fonts::FreeMono9pt7b);
  memlcd.drawString(" hold=back", 62, 80, &fonts::FreeMono9pt7b);
  memlcd.drawString(" <pairing>", 60, 110, &fonts::Orbitron_Light_24);
}

void drawPower() {
  char stringBuffer [4];
  itoa (fwdWatt,stringBuffer,10);                                                       
  memlcd.drawString(stringBuffer, 80, 29, &fonts::FreeSansBoldOblique24pt7b);   // Fwd Power string
  memlcd.fillRect(4, 105-fwdWatt, 10, fwdWatt, 0x07E0);                         // Fwd bar
  itoa (refWatt,stringBuffer,10);
  memlcd.fillRect(23, 105-refWatt, 10, refWatt, 0xF800);                        // Ref bar
}

void drawFreq() {
  String freqString = String(freq, 3);
  memlcd.drawString(freqString.c_str(), 82, 73, &fonts::FreeSansBoldOblique9pt7b);
}

void drawSwr() {
  if (swr > 3) {
    memlcd.fillRect(44, 86, 78, 30, 0xF800);
  } else if (swr > 2) {
    memlcd.fillRect(44, 86, 78, 30, 0xFDA0);
  }
  String swrString = String(swr, 1);
  memlcd.drawString(swrString.c_str(), 82, 103, &fonts::FreeSansBoldOblique9pt7b);
}

void drawHomeScreen() {
  if (currentScreen != HOME_SCREEN) return;
  drawHomeFrame();
  drawPower();
  drawFreq();
  drawSwr();
  memlcd.pushSprite(0, 0);
}

void drawPairingScreen() {
  drawPairingFrame();
  drawChannel();
  memlcd.pushSprite(0, 0);
}

void drawPairedScreen() {
  drawPairingFrame();
  memlcd.drawString(" hold=back", 62, 80, &fonts::FreeMono9pt7b);
  memlcd.drawString(" <paired>", 60, 110, &fonts::Orbitron_Light_24);
  memlcd.pushSprite(0, 0);
}

//=================================

void setup() {

  auto cfg = M5.config();
  M5.begin(cfg);
  memlcd.setColorDepth(24);
  memlcd.createSprite(128, 128);
  memlcd.setTextDatum(middle_centre);

  for (uint8_t o = 0; o < 4; o++) {
    memlcd.setRotation(o);
    memlcd.drawJpg( jpg, ~0u, 2, 0, memlcd.width(), memlcd.height(), 0, 0, 1.0, 1.0, datum_t::middle_center );
    memlcd.pushSprite(0, 0);
    delay(400);
  }
  drawHomeScreen();

  WiFi.mode(WIFI_STA);
  WiFi.setChannel(wifiChannel);
  while (!WiFi.STA.started()) {
    delay(100);
  }
  WiFi.macAddress(thisMacAddr);

  if (!broadcast.begin()) {
    printf("Failed to initialize broadcast peer\n");
  }

  printf("  MAC Address: %s\n", WiFi.macAddress().c_str());
  printf("  Channel: %d\n", wifiChannel);
  printf("Setup of esp-now complete.\n");

  preferences.begin("settings", false);
    uint8_t empty[6] = {0};
    uint8_t savedNanny[6] = {0};
    uint8_t savedWifiChannel = preferences.getUChar("wifiChannel");
    printf("savedWifiChannel = %d\n", savedWifiChannel);
    preferences.getBytes("savedNanny", savedNanny, 6);
    if (savedWifiChannel && memcmp(savedNanny, empty, sizeof(savedNanny))) {
      printf("we have a saved wifiChannel and Nanny!\n");
      wifiChannel = savedWifiChannel;
      WiFi.setChannel(wifiChannel);
      nannyPeer = new nannyPeerClass(savedNanny, wifiChannel, WIFI_IF_STA, NULL);
      nannyPeer->addPeer();
    }
  preferences.end();

}

void handleButton() {
  M5.update();
  if (M5.BtnA.wasClicked()) {
    if (currentScreen == PAIRING_SCREEN) {
      wifiChannel += 1;
      if (wifiChannel > 14) wifiChannel = 1;
      WiFi.setChannel(wifiChannel);
      drawPairingScreen();
    }
  }
  if (M5.BtnA.wasHold()) {
    switchScreen();
  }
}

void switchScreen() {
  if (currentScreen == HOME_SCREEN) {
    currentScreen = PAIRING_SCREEN;
    drawPairingScreen();
    sendPairingRequests = true;
  } else {
    currentScreen = HOME_SCREEN;
    drawHomeScreen();
    sendPairingRequests = false;
  }
}

void loop() {

  handleButton();
  setOrientation();

  if (sendPairingRequests && ((millis() - lastBroadcastMillis)) > 800) {
    lastBroadcastMillis = millis();
    if (!broadcast.sendPairRequestMessage(wifiChannel)) {
      printf("Failed to broadcast pair request message on ch %d\n", wifiChannel);
    }
  }

  delay(100);

}

constexpr uint8_t jpg[] = {0xff,0xd8,0xff,0xe0,0x00,0x10,0x4a,0x46,0x49,0x46,0x00,0x01,0x02,0x01,0x00,0x48,0x00,0x48,0x00,0x00,
0xff,0xe1,0x00,0xca,0x45,0x78,0x69,0x66,0x00,0x00,0x4d,0x4d,0x00,0x2a,0x00,0x00,0x00,0x08,0x00,0x06,
0x01,0x12,0x00,0x03,0x00,0x00,0x00,0x01,0x00,0x01,0x00,0x00,0x01,0x1a,0x00,0x05,0x00,0x00,0x00,0x01,
0x00,0x00,0x00,0x56,0x01,0x1b,0x00,0x05,0x00,0x00,0x00,0x01,0x00,0x00,0x00,0x5e,0x01,0x28,0x00,0x03,
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0xab,0x87,0x6e,0xa6,0xac,0x50,0x01,0x45,0x14,0x50,0x07,0xff,0xd9
};
